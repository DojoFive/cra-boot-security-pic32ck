## CMakeLists.txt
```
# SPDX-FileCopyrightText: Copyright (c) 2026 Dojo Five
# SPDX-License-Identifier: Apache-2.0

cmake_minimum_required(VERSION 3.20.0)
find_package(Zephyr REQUIRED HINTS $ENV{ZEPHYR_BASE})
project(cra_boot_demo)

target_sources(app PRIVATE src/main.c src/fuse.c)
```

## Kconfig
```
# SPDX-FileCopyrightText: Copyright (c) 2026 Dojo Five
# SPDX-License-Identifier: Apache-2.0

config DEMO_BLINK_MS
	int "LED toggle period in milliseconds"
	default 1000
	help
	  Every vendor release blinks at the default, once a second. The
	  attacker's builds set 250, and so does the factory command left in
	  the v1.x releases.

config DEMO_GOT_YOU
	string "Attacker banner"
	help
	  Set only in the attacker builds (attacker/*.conf). When not empty the
	  application prints "Got you! <this>" after its banner, so the
	  audience sees attacker code running.

config DEMO_FACTORY_UNLOCK
	bool "Leftover factory unlock command"
	default y
	help
	  The known hole in the v1.x releases: MCUmgr command 1 of the fuse group clears
	  the simulated debug lock and speeds up the blink. The v2.x releases and the attacker builds turn it off.
	  Replaying a genuine, signed v1.1.0 brings it back unless MCUboot
	  refuses downgrades.

source "Kconfig.zephyr"
```

## Kconfig.sysbuild
```
# SPDX-FileCopyrightText: Copyright (c) 2026 Dojo Five
# SPDX-License-Identifier: Apache-2.0

source "share/sysbuild/Kconfig"

config DEMO_DOWNGRADE_PREVENTION
	bool "MCUboot refuses updates not newer than the running image"
	default y
	help
	  Adds sysbuild/mcuboot_downgrade.conf to MCUboot. A separate fragment
	  because a choice member cannot be turned off from a later one.
```

## prj.conf
```kconfig
CONFIG_GPIO=y
CONFIG_PRINTK=y

# Image confirmation after a successful boot
CONFIG_FLASH=y
CONFIG_FLASH_MAP=y
CONFIG_STREAM_FLASH=y
CONFIG_IMG_MANAGER=y
CONFIG_MCUBOOT_BOOTUTIL_LIB=y
CONFIG_REBOOT=y

# MCUmgr SMP server on the console UART: uart_mcumgr owns RX, printk shares TX
CONFIG_MCUMGR=y
CONFIG_NET_BUF=y
CONFIG_ZCBOR=y
CONFIG_BASE64=y
CONFIG_CRC=y
CONFIG_CONSOLE=y
CONFIG_UART_CONSOLE=y
CONFIG_UART_MCUMGR=y
# An upload chunk arrives as two console lines. With the default of two line
# buffers, a line is dropped whenever one is still in use.
CONFIG_UART_MCUMGR_RX_BUF_COUNT=4
CONFIG_MCUMGR_TRANSPORT_UART=y
CONFIG_MCUMGR_GRP_IMG=y
CONFIG_MCUMGR_GRP_OS=y
CONFIG_SYSTEM_WORKQUEUE_STACK_SIZE=2304
CONFIG_MAIN_STACK_SIZE=2048
```

## boards/pic32ck_sg01_cnano_mcuboot.conf
```kconfig
# Sector auto-sizing cannot see partitions under the flash controller node.
CONFIG_BOOT_MAX_IMG_SECTORS_AUTO=n
CONFIG_BOOT_MAX_IMG_SECTORS=256
```

## boards/pic32ck_sg01_cnano.overlay
```dts
/*
 * SPDX-FileCopyrightText: Copyright (c) 2026 Dojo Five
 * SPDX-License-Identifier: Apache-2.0
 */

/ {
	chosen {
		zephyr,uart-mcumgr = &sercom5;
	};
};
```

## boards/pic32ck_sg01_cnano_mcuboot.overlay
```dts
/*
 * SPDX-FileCopyrightText: Copyright (c) 2026 Dojo Five
 * SPDX-License-Identifier: Apache-2.0
 */

/ {
	chosen {
		zephyr,code-partition = &boot_partition;
	};
};
```

## src/main.c
```c
/*
 * SPDX-FileCopyrightText: Copyright (c) 2026 Dojo Five
 * SPDX-License-Identifier: Apache-2.0
 */

#include <zephyr/kernel.h>
#include <zephyr/drivers/gpio.h>
#include <zephyr/dfu/mcuboot.h>
#include <zephyr/sys/printk.h>

#include "fuse.h"

static const struct gpio_dt_spec led = GPIO_DT_SPEC_GET(DT_ALIAS(led0), gpios);

/* The product's one job is this blink period; fuse.c explains who else can change it. */
int demo_blink_ms = CONFIG_DEMO_BLINK_MS;

int main(void)
{
	int err;

	printk("cra_boot_demo v%s, blink %d ms, fuse %s\n", CONFIG_MCUBOOT_IMGTOOL_SIGN_VERSION,
	       CONFIG_DEMO_BLINK_MS, fuse_is_locked() ? "locked" : "clear");
	if (CONFIG_DEMO_GOT_YOU[0] != '\0') {
		printk("Got you! %s\n", CONFIG_DEMO_GOT_YOU);
	}

	if (!boot_is_img_confirmed()) {
		err = boot_write_img_confirmed();
		printk("image confirm: %s (%d)\n", err == 0 ? "ok" : "failed", err);
	}

	err = gpio_pin_configure_dt(&led, GPIO_OUTPUT_INACTIVE);
	if (err != 0) {
		printk("led init failed (%d)\n", err);
		return 0;
	}

	while (true) {
		(void)gpio_pin_toggle_dt(&led);
		k_msleep(demo_blink_ms);
	}

	return 0;
}
```

## src/fuse.c
```c
/*
 * SPDX-FileCopyrightText: Copyright (c) 2026 Dojo Five
 * SPDX-License-Identifier: Apache-2.0
 *
 * Simulated one-time fuse. A marker at the start of the storage partition
 * stands in for the debug lock a production part gets from its DAL/OTP
 * settings. Firmware can set it but never clear it; the host clears it with a
 * chip erase, as it would on real silicon. The exception is the demo's known
 * hole, CONFIG_DEMO_FACTORY_UNLOCK, left in the v1.x releases.
 */

#include <string.h>
#include <zephyr/kernel.h>
#include <zephyr/drivers/flash.h>
#include <zephyr/storage/flash_map.h>
#include <zephyr/mgmt/mcumgr/mgmt/mgmt.h>
#include <zephyr/mgmt/mcumgr/mgmt/handlers.h>
#include <zephyr/mgmt/mcumgr/smp/smp.h>
#include <zephyr/sys/printk.h>
#include <zcbor_encode.h>

#include "fuse.h"

static const uint8_t fuse_magic[16] = "CRA-DEMO-LOCKED";

bool fuse_is_locked(void)
{
	const struct flash_area *fa;
	uint8_t buf[sizeof(fuse_magic)];
	int err;

	err = flash_area_open(PARTITION_ID(storage_partition), &fa);
	if (err != 0) {
		return false;
	}

	err = flash_area_read(fa, 0, buf, sizeof(buf));
	flash_area_close(fa);

	return (err == 0) && (memcmp(buf, fuse_magic, sizeof(buf)) == 0);
}

int fuse_lock(void)
{
	const struct flash_area *fa;
	const struct flash_parameters *params;
	uint8_t erased[sizeof(fuse_magic)];
	uint8_t buf[sizeof(fuse_magic)];
	int err;

	if (fuse_is_locked()) {
		return 0;
	}

	err = flash_area_open(PARTITION_ID(storage_partition), &fa);
	if (err != 0) {
		return err;
	}

	params = flash_get_parameters(flash_area_get_device(fa));
	memset(erased, params->erase_value, sizeof(erased));

	err = flash_area_read(fa, 0, buf, sizeof(buf));
	if ((err == 0) && (memcmp(buf, erased, sizeof(buf)) != 0)) {
		err = flash_area_erase(fa, 0, fa->fa_size);
	}
	if (err == 0) {
		err = flash_area_write(fa, 0, fuse_magic, sizeof(fuse_magic));
	}

	flash_area_close(fa);
	return err;
}

#ifdef CONFIG_DEMO_FACTORY_UNLOCK
static int fuse_clear(void)
{
	const struct flash_area *fa;
	int err;

	err = flash_area_open(PARTITION_ID(storage_partition), &fa);
	if (err != 0) {
		return err;
	}

	err = flash_area_erase(fa, 0, fa->fa_size);
	flash_area_close(fa);
	return err;
}
#endif

static bool fuse_encode_state(struct smp_streamer *ctxt)
{
	zcbor_state_t *zse = ctxt->writer->zs;

	return zcbor_tstr_put_lit(zse, "locked") && zcbor_bool_put(zse, fuse_is_locked());
}

static int fuse_mgmt_read(struct smp_streamer *ctxt)
{
	return fuse_encode_state(ctxt) ? MGMT_ERR_EOK : MGMT_ERR_EMSGSIZE;
}

static int fuse_mgmt_write(struct smp_streamer *ctxt)
{
	if (fuse_lock() != 0) {
		return MGMT_ERR_EUNKNOWN;
	}

	return fuse_encode_state(ctxt) ? MGMT_ERR_EOK : MGMT_ERR_EMSGSIZE;
}

#ifdef CONFIG_DEMO_FACTORY_UNLOCK
static int fuse_mgmt_factory_unlock(struct smp_streamer *ctxt)
{
	if (fuse_clear() != 0) {
		return MGMT_ERR_EUNKNOWN;
	}

	demo_blink_ms = FUSE_FACTORY_BLINK_MS;
	printk("Got you! v%s factory command: blink %d ms, debug lock cleared\n",
	       CONFIG_MCUBOOT_IMGTOOL_SIGN_VERSION, demo_blink_ms);

	return fuse_encode_state(ctxt) ? MGMT_ERR_EOK : MGMT_ERR_EMSGSIZE;
}
#endif

static const struct mgmt_handler fuse_mgmt_handlers[] = {
	[FUSE_MGMT_CMD_STATE] = {
		.mh_read = fuse_mgmt_read,
		.mh_write = fuse_mgmt_write,
	},
#ifdef CONFIG_DEMO_FACTORY_UNLOCK
	[FUSE_MGMT_CMD_FACTORY_UNLOCK] = {
		.mh_write = fuse_mgmt_factory_unlock,
	},
#endif
};

static struct mgmt_group fuse_mgmt_group = {
	.mg_handlers = fuse_mgmt_handlers,
	.mg_handlers_count = ARRAY_SIZE(fuse_mgmt_handlers),
	.mg_group_id = FUSE_MGMT_GROUP,
};

static void fuse_mgmt_init(void)
{
	mgmt_register_group(&fuse_mgmt_group);
}

MCUMGR_HANDLER_DEFINE(fuse_mgmt, fuse_mgmt_init);
```

## src/fuse.h
```c
/*
 * SPDX-FileCopyrightText: Copyright (c) 2026 Dojo Five
 * SPDX-License-Identifier: Apache-2.0
 */

#ifndef CRA_BOOT_DEMO_FUSE_H_
#define CRA_BOOT_DEMO_FUSE_H_

#include <stdbool.h>

/** MCUmgr group of the simulated debug-lock fuse. */
#define FUSE_MGMT_GROUP 64U

/** Command 0: read returns {"locked": bool}, write sets the fuse. */
#define FUSE_MGMT_CMD_STATE 0U

/** Command 1, CONFIG_DEMO_FACTORY_UNLOCK only: write clears the fuse and speeds up the blink. */
#define FUSE_MGMT_CMD_FACTORY_UNLOCK 1U

/** Blink period the leftover factory command switches to, in milliseconds. */
#define FUSE_FACTORY_BLINK_MS 250

/** Current blink period in milliseconds, owned by main.c. */
extern int demo_blink_ms;

/**
 * @brief Report whether the simulated fuse is set.
 *
 * @retval true The marker is present in the storage partition.
 * @retval false The marker is absent or the partition cannot be read.
 */
bool fuse_is_locked(void);

/**
 * @brief Set the simulated fuse. Only a chip erase clears it.
 *
 * @retval 0 Fuse set or already set.
 * @retval -errno Flash access failed.
 */
int fuse_lock(void);

#endif /* CRA_BOOT_DEMO_FUSE_H_ */
```
